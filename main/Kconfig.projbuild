## main/Kconfig.projbuild
```kconfig
# put custom config values here
menu "Custom Network etc. Configuration"

    config WIFI_SSID
        string "WiFi SSID"
        default "myssid"
        help
            SSID (network name) for the board to connect to.

    config WIFI_PASSWORD
        string "WiFi Password"
        default "mypassword"
        help
            WiFi password (WPA or WPA2) for the board to use.

    config BROKER_URL
        string "Broker URL"
        default "mqtt://broker_ip:1883"
        help
            URL of the broker to connect to.

    config DEVICE_NAME
        string "Device Name"
        default "IOT Board"
        help
            Desired name of your device.

endmenu
```
